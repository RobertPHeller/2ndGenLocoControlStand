## ESP32-S3-WROOM-ControlStand/firmware/sdkconfig.defaults
```kconfig
#
# Bootloader config
#
CONFIG_BOOTLOADER_LOG_LEVEL_NONE=y

#
# Serial flasher config
#
CONFIG_ESPTOOLPY_FLASHSIZE_4MB=y

#
# Heap memory debugging
#
CONFIG_HEAP_POISONING_LIGHT=y

#
# Partition Table
#
CONFIG_PARTITION_TABLE_CUSTOM=y
CONFIG_PARTITION_TABLE_CUSTOM_FILENAME="esp32s3controlstand-partitions.csv"

#
# Log output
#
CONFIG_LOG_DEFAULT_LEVEL_ERROR=y
CONFIG_LOG_COLORS=n
CONFIG_LOG_TIMESTAMP_SOURCE_RTOS=y

#
# Compiler options
#
CONFIG_COMPILER_OPTIMIZATION_PERF=y
CONFIG_COMPILER_OPTIMIZATION_ASSERTIONS_ENABLE=y
CONFIG_COMPILER_CXX_EXCEPTIONS=y
CONFIG_COMPILER_STACK_CHECK_MODE_NORM=y
CONFIG_COMPILER_STACK_CHECK=y
CONFIG_COMPILER_WARN_WRITE_STRINGS=y

#
# ESP32 Specific
#
# NOTE: ESP-IDF defaults to 160Mhz mode!
CONFIG_ESP32_DEFAULT_CPU_FREQ_240=y
CONFIG_ESP32_XTAL_FREQ_AUTO=y

#
# Common ESP-related
#
CONFIG_ESP_MAIN_TASK_STACK_SIZE=4096
CONFIG_ESP_CONSOLE_UART=y
CONFIG_ESP_SYSTEM_EVENT_TASK_STACK_SIZE=2048

#
# FreeRTOS configuration
#
CONFIG_FREERTOS_HZ=1000
CONFIG_FREERTOS_IDLE_TASK_STACKSIZE=1024
CONFIG_FREERTOS_WATCHPOINT_END_OF_STACK=y

#
# libsodium
#
CONFIG_LIBSODIUM_USE_MBEDTLS_SHA=y

#
# LwIP configuration
#
CONFIG_LWIP_SO_RCVBUF=y
CONFIG_LWIP_LOCAL_HOSTNAME="esp32io"
# disable IRAM optimization due to https://github.com/espressif/esp-idf/issues/5734
CONFIG_LWIP_IRAM_OPTIMIZATION=n
CONFIG_LWIP_MAX_SOCKETS=16
CONFIG_LWIP_ETHARP_TRUST_IP_MAC=y
CONFIG_LWIP_DHCP_RESTORE_LAST_IP=y
CONFIG_LWIP_MAX_LISTENING_TCP=5
# Increase MSS to maximum value (1460)
CONFIG_LWIP_TCP_MSS=1460
# SNDBUF size is 6x MSS
CONFIG_LWIP_TCP_SND_BUF_DEFAULT=8760
# WND size is 10x MSS
CONFIG_LWIP_TCP_WND_DEFAULT=14600
# RECVMBOX is (WND / MSS) + 2
CONFIG_LWIP_TCP_RECVMBOX_SIZE=22
CONFIG_LWIP_TCPIP_RECVMBOX_SIZE=64
CONFIG_LWIP_TCPIP_TASK_STACK_SIZE=2560
CONFIG_LWIP_DHCP_DOES_ARP_CHECK=n

#
# UDP
#
CONFIG_LWIP_MAX_UDP_PCBS=8

#
# Wi-Fi configuration
#
CONFIG_ESP32_WIFI_NVS_ENABLED=n
CONFIG_ESP32_WIFI_STATIC_RX_BUFFER_NUM=16
CONFIG_ESP32_WIFI_RX_BA_WIN=16
CONFIG_ESP32_WIFI_RX_IRAM_OPT=n
CONFIG_ESP32_WIFI_IRAM_OPT=n
#
# Watchdog configuration
#
CONFIG_ESP_TASK_WDT=n

CONFIG_ESP_CONSOLE_USB_SERIAL_JTAG=y
```
